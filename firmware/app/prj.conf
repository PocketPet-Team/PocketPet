## CMakeLists.txt
```
cmake_minimum_required(VERSION 3.20.0)

find_package(Zephyr REQUIRED HINTS $ENV{ZEPHYR_BASE})
project(pocketpet_app LANGUAGES C)

# The portable cores are shared with the host replays in ../host.
set(POCKETPET_CORE_DIR ${CMAKE_CURRENT_SOURCE_DIR}/../core)

target_include_directories(app PRIVATE ${POCKETPET_CORE_DIR})
target_sources(app PRIVATE
    src/main.c
    src/pet_service.c
    ${POCKETPET_CORE_DIR}/pet_state.c
    ${POCKETPET_CORE_DIR}/adv_policy.c
    ${POCKETPET_CORE_DIR}/marker.c
    ${POCKETPET_CORE_DIR}/sync_policy.c
)
target_sources_ifdef(CONFIG_POCKETPET_PPK2_MARKERS app PRIVATE src/markers.c)
```

## Kconfig
```
menu "PocketPet"

config POCKETPET_RQ2
	bool "Use a single preferred BLE interval for an RQ2 trial"
	depends on BT_GAP_AUTO_UPDATE_CONN_PARAMS && BT_GAP_PERIPHERAL_PREF_PARAMS
	help
	  Let the Zephyr peripheral request its preferred interval on each link.
	  Log the active interval so the operator can identify a phone override.

# The defaults below make the application run. They are not pilot values; RQ3
# fixes the intervals and the switch time during pilot runs.

config POCKETPET_ADV_FAST_INTERVAL
	int "Fast advertising interval (0.625 ms units)"
	range 32 16384
	default 160
	help
	  Interval used right after the link is lost. 160 units is 100 ms.

config POCKETPET_ADV_SLOW_INTERVAL
	int "Slow advertising interval (0.625 ms units)"
	range 32 16384
	default 1600
	help
	  Interval used after the fast period. Set it equal to
	  POCKETPET_ADV_FAST_INTERVAL for the fixed-rate baseline. 1600 units
	  is 1 s.

config POCKETPET_ADV_FAST_DURATION_MS
	int "Time at the fast interval before switching (ms)"
	range 1 4294967
	default 30000

config POCKETPET_ROUTINE_SYNC_PERIOD_S
	int "Routine state sync period (s)"
	range 1 86400
	default 300
	help
	  How often a routine state update becomes due.

config POCKETPET_SYNC_MAX_HOLD_MS
	int "Longest a routine update may wait to share a transfer (ms)"
	range 0 86400000
	default 0
	help
	  0 sends every routine update when it is due, which is the unbatched
	  baseline for RQ4. A larger value holds an update for up to that long
	  so later updates, or a Find exchange, share its transfer. RQ4 sets
	  the freshness limit this value must respect.

config POCKETPET_FIND_INDICATION_MS
	int "Find indication length (ms)"
	default 500
	help
	  How long the stand-in for the haptic motor stays on.

config POCKETPET_PPK2_MARKERS
	bool "Drive PPK2 logic markers"
	default y
	depends on DT_HAS_POCKETPET_PPK2_MARKERS_ENABLED
	help
	  Drive the operating state and event lines described in
	  docs/ppk2-markers.md so a PPK2 capture can be split by state. Needs
	  a devicetree node with the pocketpet,ppk2-markers compatible.

endmenu

source "Kconfig.zephyr"
```

## prj.conf
```kconfig
# Bluetooth LE peripheral
CONFIG_BT=y
CONFIG_BT_PERIPHERAL=y
CONFIG_BT_DEVICE_NAME="PocketPet"
CONFIG_BT_MAX_CONN=1

# Board button and LEDs stand in for the planned display and haptic driver
CONFIG_GPIO=y

# Logging over the DK's UART for bring-up. Disable for power measurements.
CONFIG_LOG=y
```

## clock-rc.conf
```kconfig
# RQ2: run the LF clock from the calibrated internal RC oscillator instead of
# the 32.768 kHz crystal. Pass with -DEXTRA_CONF_FILE=clock-rc.conf.
CONFIG_CLOCK_CONTROL_NRF_K32SRC_RC=y
CONFIG_CLOCK_CONTROL_NRF_K32SRC_RC_CALIBRATION=y
```

## rq2-long.conf
```kconfig
CONFIG_POCKETPET_RQ2=y
CONFIG_BT_PERIPHERAL_PREF_MIN_INT=96
CONFIG_BT_PERIPHERAL_PREF_MAX_INT=96
CONFIG_BT_PERIPHERAL_PREF_LATENCY=0
CONFIG_BT_PERIPHERAL_PREF_TIMEOUT=400
CONFIG_BT_CTLR_TX_PWR_0=y
```

## rq2-short.conf
```kconfig
# Bench starting point, in 1.25 ms units. Freeze trial values after the pilot.
CONFIG_POCKETPET_RQ2=y
CONFIG_BT_PERIPHERAL_PREF_MIN_INT=24
CONFIG_BT_PERIPHERAL_PREF_MAX_INT=24
CONFIG_BT_PERIPHERAL_PREF_LATENCY=0
CONFIG_BT_PERIPHERAL_PREF_TIMEOUT=400
CONFIG_BT_CTLR_TX_PWR_0=y
```

## boards/nrf52840dk_nrf52840.overlay
```dts
/*
 * Provisional bench wiring for the PPK2 logic markers. P1.03 to P1.07 are the
 * DK's Arduino header pins D2 to D6, which no enabled peripheral of this
 * application uses. The compact board will choose its own pins.
 */
/ {
	ppk2-markers {
		compatible = "pocketpet,ppk2-markers";
		gpios = <&gpio1 3 GPIO_ACTIVE_HIGH>, /* PPK2 D0: state bit 0 */
			<&gpio1 4 GPIO_ACTIVE_HIGH>, /* PPK2 D1: state bit 1 */
			<&gpio1 5 GPIO_ACTIVE_HIGH>, /* PPK2 D2: button */
			<&gpio1 6 GPIO_ACTIVE_HIGH>, /* PPK2 D3: haptic */
			<&gpio1 7 GPIO_ACTIVE_HIGH>; /* PPK2 D4: transfer */
	};
};
```

## dts/bindings/pocketpet,ppk2-markers.yaml
```yaml
description: |
  GPIO lines that label a power capture on a Nordic PPK2's logic port.

  The lines carry the layout defined in firmware/core/marker.h: the operating
  state as a binary code on the first lines, then one line per event.

compatible: "pocketpet,ppk2-markers"

properties:
  gpios:
    type: phandle-array
    required: true
    description: |
      Marker lines in channel order, starting with the line wired to PPK2
      logic channel D0. They must be SoC GPIOs, because the firmware drives
      them from interrupt context.
```

## src/main.c
```c
/*
 * PocketPet tag application for bench bring-up on the nRF52840 DK.
 *
 * Every input (button, Bluetooth callbacks, timers) is queued and applied to
 * the portable state machines from one work item, so pet_step(),
 * adv_policy_step() and sync_policy_step() always see events in order and
 * never run concurrently.
 * The board's LED1 stands in for the display and LED2 for the haptic motor
 * until those drivers exist. The same work item keeps the PPK2 marker lines in
 * step with the state machines.
 */

#include <zephyr/bluetooth/bluetooth.h>
#include <zephyr/bluetooth/conn.h>
#include <zephyr/drivers/gpio.h>
#include <zephyr/kernel.h>
#include <zephyr/logging/log.h>
#include <zephyr/sys/atomic.h>

#include <hal/nrf_clock.h>

#include "adv_policy.h"
#include "marker.h"
#include "markers.h"
#include "pet_service.h"
#include "pet_state.h"
#include "sync_policy.h"

LOG_MODULE_REGISTER(pocketpet, LOG_LEVEL_INF);

#ifdef CONFIG_POCKETPET_RQ2
/* The GAP worker uses these same values for the PPCP and its update request. */
BUILD_ASSERT(CONFIG_BT_PERIPHERAL_PREF_MIN_INT == CONFIG_BT_PERIPHERAL_PREF_MAX_INT);
BUILD_ASSERT(IN_RANGE(CONFIG_BT_PERIPHERAL_PREF_MAX_INT, 6, 3200));
BUILD_ASSERT(IN_RANGE(CONFIG_BT_PERIPHERAL_PREF_TIMEOUT, 10, 3200));
BUILD_ASSERT(CONFIG_BT_PERIPHERAL_PREF_TIMEOUT * 4 >
             (CONFIG_BT_PERIPHERAL_PREF_LATENCY + 1) * CONFIG_BT_PERIPHERAL_PREF_MAX_INT);
BUILD_ASSERT(!IS_ENABLED(CONFIG_BT_CTLR_TX_PWR_DYNAMIC_CONTROL));
BUILD_ASSERT(!IS_ENABLED(CONFIG_BT_TRANSMIT_POWER_CONTROL));
BUILD_ASSERT(!IS_ENABLED(CONFIG_BT_CTLR_LE_POWER_CONTROL));
#endif

#define BUTTON_LOCKOUT_MS 50
#define EVENT_QUEUE_LENGTH 16

enum app_event_source {
    SOURCE_PET,
    SOURCE_ADV,
    SOURCE_SYNC,
};

struct app_event {
    uint8_t source;
    uint8_t code;
};

/*
 * Initialized in main() instead of with K_MSGQ_DEFINE, which names a linker
 * section after __FILE__ and breaks the build when the path contains a space.
 */
static struct k_msgq event_queue;
static char __aligned(4) event_queue_buffer[EVENT_QUEUE_LENGTH * sizeof(struct app_event)];

static const struct gpio_dt_spec button = GPIO_DT_SPEC_GET(DT_ALIAS(sw0), gpios);
static const struct gpio_dt_spec display_led = GPIO_DT_SPEC_GET(DT_ALIAS(led0), gpios);
static const struct gpio_dt_spec haptic_led = GPIO_DT_SPEC_GET(DT_ALIAS(led1), gpios);
static struct gpio_callback button_callback;

static const struct bt_data advertising_data[] = {
    BT_DATA_BYTES(BT_DATA_FLAGS, BT_LE_AD_GENERAL | BT_LE_AD_NO_BREDR),
    BT_DATA(BT_DATA_NAME_COMPLETE, CONFIG_BT_DEVICE_NAME, sizeof(CONFIG_BT_DEVICE_NAME) - 1),
};
static const struct bt_data scan_response_data[] = {
    BT_DATA_BYTES(BT_DATA_UUID128_ALL, PET_SERVICE_UUID_VAL),
};

/* Owned by the event work item. */
static struct pet_state pet;
static struct adv_policy advertising;
static struct sync_policy routine_sync;

/* Shared with the Bluetooth RX thread. */
static struct bt_conn *current_conn;
static atomic_t notifications_enabled;

static void process_events(struct k_work *work);
static void switch_timer_expired(struct k_work *work);
static void routine_sync_due(struct k_work *work);
static void hold_timer_expired(struct k_work *work);
static void find_indication_done(struct k_work *work);

static K_WORK_DEFINE(event_work, process_events);
static K_WORK_DELAYABLE_DEFINE(switch_timer, switch_timer_expired);
static K_WORK_DELAYABLE_DEFINE(routine_sync_timer, routine_sync_due);
static K_WORK_DELAYABLE_DEFINE(hold_timer, hold_timer_expired);
static K_WORK_DELAYABLE_DEFINE(find_indication_timer, find_indication_done);

/* Safe from interrupts and any thread. Returns false if the event was dropped. */
static bool queue_event(enum app_event_source source, uint8_t code)
{
    const struct app_event event = {.source = source, .code = code};

    if (k_msgq_put(&event_queue, &event, K_NO_WAIT) != 0) {
        LOG_ERR("Event queue full, dropped source %u code %u", source, code);
        return false;
    }
    k_work_submit(&event_work);
    return true;
}

static void start_advertising(uint16_t interval_units)
{
    const struct bt_le_adv_param param =
        BT_LE_ADV_PARAM_INIT(BT_LE_ADV_OPT_CONN, interval_units, interval_units, NULL);

    // The new interval only takes effect after a restart.
    (void)bt_le_adv_stop();
    const int err = bt_le_adv_start(&param, advertising_data, ARRAY_SIZE(advertising_data),
                                    scan_response_data, ARRAY_SIZE(scan_response_data));
    if (err != 0) {
        LOG_ERR("Advertising start failed (%d)", err);
        return;
    }
    LOG_INF("Advertising every %u.%03u ms", (interval_units * 625U) / 1000U,
            (interval_units * 625U) % 1000U);
}

static void apply_adv_action(const struct adv_action *action, uint64_t now_ms)
{
    if (action->cancel_switch_timer) {
        (void)k_work_cancel_delayable(&switch_timer);
    }
    if (action->start) {
        start_advertising(action->interval_units);
    }
    if (action->arm_switch_timer) {
        (void)k_work_reschedule(&switch_timer, K_MSEC(action->switch_deadline_ms - now_ms));
    }
}

static void apply_pet_action(enum pet_action action)
{
    switch (action) {
    case PET_ACTION_REFRESH_DISPLAY:
        (void)gpio_pin_toggle_dt(&display_led);
        LOG_INF("Display refresh, mood %u", pet.mood);
        break;
    case PET_ACTION_START_HAPTIC:
        markers_set_event(MARKER_EVENT_HAPTIC, true);
        (void)gpio_pin_set_dt(&haptic_led, 1);
        (void)k_work_reschedule(&find_indication_timer,
                                K_MSEC(CONFIG_POCKETPET_FIND_INDICATION_MS));
        LOG_INF("Find indication");
        break;
    case PET_ACTION_SEND_STATE: {
        markers_set_event(MARKER_EVENT_TRANSFER, true);
        const int err = pet_service_notify_state();
        if (err != 0) {
            // Nothing was queued, so state_sent() will not end the marker.
            markers_set_event(MARKER_EVENT_TRANSFER, false);
            LOG_WRN("State notification failed (%d)", err);
        }
        break;
    }
    case PET_ACTION_NONE:
    default:
        break;
    }
}

static void process_pet_event(enum pet_event event, uint64_t now_ms)
{
    // Keep a routine update pending until a peer can receive it.
    if (event == PET_EVENT_FLUSH_ROUTINE_SYNC && !atomic_get(&notifications_enabled)) {
        return;
    }
    enum pet_action action;
    if (pet_step(&pet, event, now_ms, &action)) {
        pet_service_set_mood(pet.mood);
        apply_pet_action(action);
    }
    if (event == PET_EVENT_BUTTON) {
        // Raised in button_pressed(); the press is handled once its action is applied.
        markers_set_event(MARKER_EVENT_BUTTON, false);
    }
}

static void process_sync_event(enum sync_event event, uint64_t now_ms)
{
    struct sync_action action;

    if (!sync_policy_step(&routine_sync, event, now_ms, &action)) {
        return;
    }
    if (action.cancel_hold_timer) {
        (void)k_work_cancel_delayable(&hold_timer);
    }
    if (action.arm_hold_timer) {
        (void)k_work_reschedule(&hold_timer, K_MSEC(action.hold_deadline_ms - now_ms));
    }
    if (action.flush) {
        LOG_INF("Routine transfer for %u updates", action.flushed_updates);
    }
    // A new subscriber also gets an update that a flush could not deliver
    // because the previous peer had just left.
    if (action.flush || event == SYNC_EVENT_LINK_READY) {
        process_pet_event(PET_EVENT_FLUSH_ROUTINE_SYNC, now_ms);
    }
}

static void process_events(struct k_work *work)
{
    ARG_UNUSED(work);
    struct app_event event;

    while (k_msgq_get(&event_queue, &event, K_NO_WAIT) == 0) {
        // Timestamps are taken here, in processing order, so they never go backwards.
        const uint64_t now_ms = (uint64_t)k_uptime_get();

        if (event.source == SOURCE_ADV) {
            struct adv_action action;
            if (adv_policy_step(&advertising, (enum adv_event)event.code, now_ms, &action)) {
                apply_adv_action(&action, now_ms);
            }
        } else if (event.source == SOURCE_SYNC) {
            process_sync_event((enum sync_event)event.code, now_ms);
        } else {
            process_pet_event((enum pet_event)event.code, now_ms);
        }
        // After the action, so the state line changes once advertising has restarted.
        markers_set_state(marker_state_for(pet.connected, advertising.phase));
    }
}

static void switch_timer_expired(struct k_work *work)
{
    ARG_UNUSED(work);
    queue_event(SOURCE_ADV, ADV_EVENT_SWITCH_TIMER);
}

static void routine_sync_due(struct k_work *work)
{
    ARG_UNUSED(work);
    queue_event(SOURCE_PET, PET_EVENT_ROUTINE_SYNC_DUE);
    // The sync policy decides when the update goes out.
    queue_event(SOURCE_SYNC, SYNC_EVENT_UPDATE);
    (void)k_work_schedule(&routine_sync_timer, K_SECONDS(CONFIG_POCKETPET_ROUTINE_SYNC_PERIOD_S));
}

static void hold_timer_expired(struct k_work *work)
{
    ARG_UNUSED(work);
    queue_event(SOURCE_SYNC, SYNC_EVENT_HOLD_TIMER);
}

static void find_indication_done(struct k_work *work)
{
    ARG_UNUSED(work);
    (void)gpio_pin_set_dt(&haptic_led, 0);
    markers_set_event(MARKER_EVENT_HAPTIC, false);
}

static void button_pressed(const struct device *port, struct gpio_callback *callback,
                           uint32_t pins)
{
    ARG_UNUSED(port);
    ARG_UNUSED(callback);
    ARG_UNUSED(pins);
    static int64_t last_press_ms = -BUTTON_LOCKOUT_MS;

    // The first edge is acted on at once; contact bounce right after it is ignored.
    const int64_t now_ms = k_uptime_get();
    if (now_ms - last_press_ms < BUTTON_LOCKOUT_MS) {
        return;
    }
    last_press_ms = now_ms;
    // Raised here so the marker covers the wait for the work item as well.
    markers_set_event(MARKER_EVENT_BUTTON, true);
    if (!queue_event(SOURCE_PET, PET_EVENT_BUTTON)) {
        markers_set_event(MARKER_EVENT_BUTTON, false);
    }
}

static void log_connection_parameters(struct bt_conn *conn, const char *when)
{
    struct bt_conn_info info;

    if (bt_conn_get_info(conn, &info) == 0) {
        LOG_INF("%s: interval %u us, latency %u, timeout %u ms", when, info.le.interval_us,
                info.le.latency, info.le.timeout * 10U);
#ifdef CONFIG_POCKETPET_RQ2
        const unsigned int target_us = CONFIG_BT_PERIPHERAL_PREF_MIN_INT * 1250U;
        LOG_INF("RQ2 target_us=%u active_us=%u target_latency=%u active_latency=%u "
                "configured_tx_dbm=%d match=%u",
                target_us, info.le.interval_us, (unsigned)CONFIG_BT_PERIPHERAL_PREF_LATENCY,
                info.le.latency, CONFIG_BT_CTLR_TX_PWR_DBM,
                (unsigned)(info.le.interval_us == target_us &&
                           info.le.latency == CONFIG_BT_PERIPHERAL_PREF_LATENCY));
#endif
    } else {
        LOG_WRN("Active connection parameters unavailable at %s", when);
    }
}

static void connected(struct bt_conn *conn, uint8_t err)
{
    if (err != 0) {
        LOG_WRN("Connection failed (0x%02x)", err);
        return;
    }
    current_conn = bt_conn_ref(conn);
    log_connection_parameters(conn, "Connected");
    // The pet learns of the link first, so the state marker goes straight from
    // advertising to connected without passing through idle.
    queue_event(SOURCE_PET, PET_EVENT_LINK_CONNECTED);
    queue_event(SOURCE_ADV, ADV_EVENT_LINK_CONNECTED);
}

static void disconnected(struct bt_conn *conn, uint8_t reason)
{
    ARG_UNUSED(conn);
    LOG_INF("Disconnected (0x%02x)", reason);
    atomic_set(&notifications_enabled, false);
    // The stack drops an unsent notification without calling state_sent().
    markers_set_event(MARKER_EVENT_TRANSFER, false);
    if (current_conn != NULL) {
        bt_conn_unref(current_conn);
        current_conn = NULL;
    }
    queue_event(SOURCE_PET, PET_EVENT_LINK_DISCONNECTED);
    queue_event(SOURCE_SYNC, SYNC_EVENT_LINK_LOST);
}

/*
 * Advertising restarts here rather than in disconnected(): until the
 * connection object is released, starting connectable advertising can fail.
 */
static void recycled(void)
{
    queue_event(SOURCE_ADV, ADV_EVENT_LINK_LOST);
}

static void parameters_updated(struct bt_conn *conn, uint16_t interval, uint16_t latency,
                               uint16_t timeout)
{
    ARG_UNUSED(interval);
    ARG_UNUSED(latency);
    ARG_UNUSED(timeout);
#ifdef CONFIG_POCKETPET_RQ2
    pet_service_note_param_update();
#endif
    log_connection_parameters(conn, "Parameters updated");
}

BT_CONN_CB_DEFINE(connection_callbacks) = {
    .connected = connected,
    .disconnected = disconnected,
    .recycled = recycled,
    .le_param_updated = parameters_updated,
};

static void find_requested(void)
{
    queue_event(SOURCE_PET, PET_EVENT_FIND);
    // Queued behind the Find itself, so a held update shares this exchange
    // without delaying the indication.
    queue_event(SOURCE_SYNC, SYNC_EVENT_RADIO_ACTIVE);
}

static void notifications_changed(bool enabled)
{
    atomic_set(&notifications_enabled, enabled);
    queue_event(SOURCE_SYNC, enabled ? SYNC_EVENT_LINK_READY : SYNC_EVENT_LINK_LOST);
}

static void state_sent(void)
{
    markers_set_event(MARKER_EVENT_TRANSFER, false);
}

static const struct pet_service_callbacks service_callbacks = {
    .find_requested = find_requested,
    .notifications_changed = notifications_changed,
    .state_sent = state_sent,
};

static int init_gpio(void)
{
    if (!gpio_is_ready_dt(&button) || !gpio_is_ready_dt(&display_led) ||
        !gpio_is_ready_dt(&haptic_led)) {
        return -ENODEV;
    }

    int err = gpio_pin_configure_dt(&display_led, GPIO_OUTPUT_INACTIVE);
    err = err ? err : gpio_pin_configure_dt(&haptic_led, GPIO_OUTPUT_INACTIVE);
    err = err ? err : gpio_pin_configure_dt(&button, GPIO_INPUT);
    err = err ? err : gpio_pin_interrupt_configure_dt(&button, GPIO_INT_EDGE_TO_ACTIVE);
    if (err != 0) {
        return err;
    }
    gpio_init_callback(&button_callback, button_pressed, BIT(button.pin));
    return gpio_add_callback_dt(&button, &button_callback);
}

/* Report the LF clock that is running, not only the one configured. */
static void log_lf_clock(void)
{
    nrf_clock_lfclk_t source;
    const char *name = "not running";

    if (nrf_clock_is_running(NRF_CLOCK, NRF_CLOCK_DOMAIN_LFCLK, &source)) {
        switch (source) {
        case NRF_CLOCK_LFCLK_RC:
            name = "RC";
            break;
        case NRF_CLOCK_LFCLK_XTAL:
            name = "crystal";
            break;
        case NRF_CLOCK_LFCLK_SYNTH:
            name = "synthesized";
            break;
        default:
            name = "unknown";
            break;
        }
    }
    LOG_INF("LF clock: %s (configured %s)", name,
            IS_ENABLED(CONFIG_CLOCK_CONTROL_NRF_K32SRC_RC) ? "RC" : "crystal");
}

int main(void)
{
    static const struct adv_policy_config adv_config = {
        .fast_interval_units = CONFIG_POCKETPET_ADV_FAST_INTERVAL,
        .slow_interval_units = CONFIG_POCKETPET_ADV_SLOW_INTERVAL,
        .fast_duration_ms = CONFIG_POCKETPET_ADV_FAST_DURATION_MS,
    };
    static const struct sync_policy_config sync_config = {
        .max_hold_ms = CONFIG_POCKETPET_SYNC_MAX_HOLD_MS,
    };
    const uint64_t now_ms = (uint64_t)k_uptime_get();

    k_msgq_init(&event_queue, event_queue_buffer, sizeof(struct app_event), EVENT_QUEUE_LENGTH);
    pet_init(&pet, now_ms);
    sync_policy_init(&routine_sync, &sync_config, now_ms);
    pet_service_set_mood(pet.mood);
    if (!adv_policy_init(&advertising, &adv_config, now_ms)) {
        LOG_ERR("Invalid advertising configuration");
        return 0;
    }

    int err = init_gpio();
    if (err != 0) {
        LOG_ERR("GPIO init failed (%d)", err);
        return 0;
    }
    err = markers_init();
    if (err != 0) {
        LOG_ERR("Marker init failed (%d)", err);
        return 0;
    }

    pet_service_init(&service_callbacks);
    err = bt_enable(NULL);
    if (err != 0) {
        LOG_ERR("Bluetooth init failed (%d)", err);
        return 0;
    }
    log_lf_clock();

    // Boot counts as a lost link, so advertising starts at the fast rate.
    queue_event(SOURCE_ADV, ADV_EVENT_LINK_LOST);
    (void)k_work_schedule(&routine_sync_timer, K_SECONDS(CONFIG_POCKETPET_ROUTINE_SYNC_PERIOD_S));
    return 0;
}
```

## src/markers.c
```c
#include "markers.h"

#include <errno.h>

#include <zephyr/devicetree.h>
#include <zephyr/drivers/gpio.h>
#include <zephyr/kernel.h>
#include <zephyr/sys/util.h>

#define DT_DRV_COMPAT pocketpet_ppk2_markers

#define MARKER_LINE(node, property, index) GPIO_DT_SPEC_GET_BY_IDX(node, property, index),

static const struct gpio_dt_spec lines[] = {
    DT_FOREACH_PROP_ELEM(DT_DRV_INST(0), gpios, MARKER_LINE)
};

BUILD_ASSERT(ARRAY_SIZE(lines) == MARKER_CHANNEL_COUNT,
             "ppk2-markers must list one GPIO per line in marker.h");

/* Guards the fields below and keeps a level change from being interrupted. */
static struct k_spinlock lock;
static enum marker_state current_state = MARKER_STATE_IDLE;
static uint8_t active_events;
static uint8_t driven_levels;

/* Call with the lock held. Writes only the lines whose level changes. */
static void drive_lines(void)
{
    const uint8_t levels = marker_levels(current_state, active_events);
    const uint8_t changed = levels ^ driven_levels;

    for (size_t line = 0; line < ARRAY_SIZE(lines); line++) {
        if (changed & BIT(line)) {
            (void)gpio_pin_set_dt(&lines[line], (levels >> line) & 1U);
        }
    }
    driven_levels = levels;
}

int markers_init(void)
{
    for (size_t line = 0; line < ARRAY_SIZE(lines); line++) {
        if (!gpio_is_ready_dt(&lines[line])) {
            return -ENODEV;
        }
        const int err = gpio_pin_configure_dt(&lines[line], GPIO_OUTPUT_INACTIVE);
        if (err != 0) {
            return err;
        }
    }
    return 0;
}

void markers_set_state(enum marker_state state)
{
    const k_spinlock_key_t key = k_spin_lock(&lock);

    current_state = state;
    drive_lines();
    k_spin_unlock(&lock, key);
}

void markers_set_event(enum marker_event event, bool active)
{
    const k_spinlock_key_t key = k_spin_lock(&lock);

    WRITE_BIT(active_events, event, active);
    drive_lines();
    k_spin_unlock(&lock, key);
}
```

## src/markers.h
```c
#ifndef POCKETPET_MARKERS_H
#define POCKETPET_MARKERS_H

#include <stdbool.h>

#include "marker.h"

/*
 * Drives the logic lines a PPK2 records next to the current, using the layout
 * in marker.h. Without CONFIG_POCKETPET_PPK2_MARKERS every call does nothing.
 */
#ifdef CONFIG_POCKETPET_PPK2_MARKERS

/* Configure the lines and drive them low; returns 0 or a negative errno. */
int markers_init(void);

/* Select the operating state. Safe from interrupts and any thread. */
void markers_set_state(enum marker_state state);

/*
 * Raise or lower an event line. Safe from interrupts and any thread. A line
 * has no count: a second start while it is high joins the pulse already open.
 */
void markers_set_event(enum marker_event event, bool active);

#else

static inline int markers_init(void)
{
    return 0;
}

static inline void markers_set_state(enum marker_state state)
{
    (void)state;
}

static inline void markers_set_event(enum marker_event event, bool active)
{
    (void)event;
    (void)active;
}

#endif

#endif
```

## src/pet_service.c
```c
#include "pet_service.h"

#include <errno.h>

#include <zephyr/bluetooth/att.h>
#include <zephyr/bluetooth/conn.h>
#include <zephyr/bluetooth/gatt.h>
#include <zephyr/sys/atomic.h>
#include <zephyr/sys/byteorder.h>

#define FIND_REQUEST 0x01

static const struct bt_uuid_128 service_uuid = BT_UUID_INIT_128(PET_SERVICE_UUID_VAL);
static const struct bt_uuid_128 state_uuid = BT_UUID_INIT_128(PET_STATE_UUID_VAL);
static const struct bt_uuid_128 find_uuid = BT_UUID_INIT_128(PET_FIND_UUID_VAL);

static const struct pet_service_callbacks *service_callbacks;
/* Written by the application work item, read by the Bluetooth RX thread. */
static atomic_t stored_mood;

#ifdef CONFIG_POCKETPET_RQ2
static const struct bt_uuid_128 rq2_uuid = BT_UUID_INIT_128(PET_RQ2_UUID_VAL);
static atomic_t param_updates;

void pet_service_note_param_update(void)
{
    atomic_inc(&param_updates);
}

static ssize_t read_rq2(struct bt_conn *conn, const struct bt_gatt_attr *attr, void *buf,
                        uint16_t len, uint16_t offset)
{
    struct bt_conn_info info;
    uint8_t value[16];
    if (bt_conn_get_info(conn, &info) != 0) {
        return BT_GATT_ERR(BT_ATT_ERR_UNLIKELY);
    }
    value[0] = 1;
    value[1] = (uint8_t)(int8_t)CONFIG_BT_CTLR_TX_PWR_DBM;
    sys_put_le16(CONFIG_BT_PERIPHERAL_PREF_MIN_INT, &value[2]);
    sys_put_le32(info.le.interval_us, &value[4]);
    sys_put_le16(info.le.latency, &value[8]);
    sys_put_le16(info.le.timeout, &value[10]);
    sys_put_le32((uint32_t)atomic_get(&param_updates), &value[12]);
    return bt_gatt_attr_read(conn, attr, buf, len, offset, value, sizeof(value));
}
#endif

static void encode_state(uint8_t value[2])
{
    value[0] = PET_STATE_FORMAT_VERSION;
    value[1] = (uint8_t)atomic_get(&stored_mood);
}

static ssize_t read_state(struct bt_conn *conn, const struct bt_gatt_attr *attr, void *buf,
                          uint16_t len, uint16_t offset)
{
    uint8_t value[2];

    encode_state(value);
    return bt_gatt_attr_read(conn, attr, buf, len, offset, value, sizeof(value));
}

static ssize_t write_find(struct bt_conn *conn, const struct bt_gatt_attr *attr, const void *buf,
                          uint16_t len, uint16_t offset, uint8_t flags)
{
    ARG_UNUSED(conn);
    ARG_UNUSED(attr);
    ARG_UNUSED(flags);

    if (offset != 0) {
        return BT_GATT_ERR(BT_ATT_ERR_INVALID_OFFSET);
    }
    if (len != 1) {
        return BT_GATT_ERR(BT_ATT_ERR_INVALID_ATTRIBUTE_LEN);
    }
    if (((const uint8_t *)buf)[0] != FIND_REQUEST) {
        return BT_GATT_ERR(BT_ATT_ERR_VALUE_NOT_ALLOWED);
    }

    if (service_callbacks != NULL && service_callbacks->find_requested != NULL) {
        service_callbacks->find_requested();
    }
    return len;
}

static void state_ccc_changed(const struct bt_gatt_attr *attr, uint16_t value)
{
    ARG_UNUSED(attr);

    if (service_callbacks != NULL && service_callbacks->notifications_changed != NULL) {
        service_callbacks->notifications_changed(value == BT_GATT_CCC_NOTIFY);
    }
}

/*
 * No characteristic requires pairing yet, so any nearby central can read the
 * mood and trigger Find. Add security before the tag leaves the bench.
 */
BT_GATT_SERVICE_DEFINE(pet_service,
    BT_GATT_PRIMARY_SERVICE(&service_uuid),
    BT_GATT_CHARACTERISTIC(&state_uuid.uuid, BT_GATT_CHRC_READ | BT_GATT_CHRC_NOTIFY,
                           BT_GATT_PERM_READ, read_state, NULL, NULL),
    BT_GATT_CCC(state_ccc_changed, BT_GATT_PERM_READ | BT_GATT_PERM_WRITE),
    BT_GATT_CHARACTERISTIC(&find_uuid.uuid,
                           BT_GATT_CHRC_WRITE | BT_GATT_CHRC_WRITE_WITHOUT_RESP,
                           BT_GATT_PERM_WRITE, NULL, write_find, NULL),
    IF_ENABLED(CONFIG_POCKETPET_RQ2,
        (BT_GATT_CHARACTERISTIC(&rq2_uuid.uuid, BT_GATT_CHRC_READ, BT_GATT_PERM_READ,
                                read_rq2, NULL, NULL),))
);

/* Index of the state value attribute in pet_service.attrs. */
#define STATE_VALUE_ATTR 2

void pet_service_init(const struct pet_service_callbacks *callbacks)
{
    service_callbacks = callbacks;
}

void pet_service_set_mood(uint8_t mood)
{
    atomic_set(&stored_mood, mood);
}

static void state_notification_sent(struct bt_conn *conn, void *user_data)
{
    ARG_UNUSED(conn);
    ARG_UNUSED(user_data);

    if (service_callbacks != NULL && service_callbacks->state_sent != NULL) {
        service_callbacks->state_sent();
    }
}

int pet_service_notify_state(void)
{
    uint8_t value[2];
    struct bt_gatt_notify_params params = {
        .attr = &pet_service.attrs[STATE_VALUE_ATTR],
        .data = value,
        .len = sizeof(value),
        .func = state_notification_sent,
    };

    encode_state(value);
    return bt_gatt_notify_cb(NULL, &params);
}
```

## src/pet_service.h
```c
#ifndef POCKETPET_PET_SERVICE_H
#define POCKETPET_PET_SERVICE_H

#include <stdbool.h>
#include <stdint.h>

#include <zephyr/bluetooth/uuid.h>

/*
 * Provisional 128-bit UUIDs for the PocketPet GATT service. They share one
 * random base and differ in the first 32 bits.
 */
#define PET_UUID_ENCODE(id) \
    BT_UUID_128_ENCODE(0xd0f80000U | (id), 0xb8bf, 0x4fa6, 0xa92b, 0xfad4ab69a07dULL)
#define PET_SERVICE_UUID_VAL PET_UUID_ENCODE(0x0001)
#define PET_STATE_UUID_VAL PET_UUID_ENCODE(0x0002)
#define PET_FIND_UUID_VAL PET_UUID_ENCODE(0x0003)
#define PET_RQ2_UUID_VAL PET_UUID_ENCODE(0x0004)

/* Version byte at the start of the state characteristic value. */
#define PET_STATE_FORMAT_VERSION 1

struct pet_service_callbacks {
    /* A peer wrote the Find characteristic. Runs in the Bluetooth RX thread. */
    void (*find_requested)(void);
    /* A peer enabled or disabled state notifications. Runs in the Bluetooth RX thread. */
    void (*notifications_changed)(bool enabled);
    /*
     * A state notification has been transmitted. Not called for one the stack
     * drops, for example on disconnection. May run in a Bluetooth thread.
     */
    void (*state_sent)(void);
};

void pet_service_init(const struct pet_service_callbacks *callbacks);

/* Store the mood a peer reads from the state characteristic. */
void pet_service_set_mood(uint8_t mood);

#ifdef CONFIG_POCKETPET_RQ2
/* Count parameter-update callbacks so two reads can bracket a quiet capture. */
void pet_service_note_param_update(void);
#endif

/* Notify subscribed peers of the stored mood; returns 0 or a negative errno. */
int pet_service_notify_state(void);

#endif
```
